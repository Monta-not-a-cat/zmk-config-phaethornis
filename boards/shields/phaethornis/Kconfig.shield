## boards/shields/phaethornis/Kconfig.shield
```kconfig
config SHIELD_PHAETHORNIS_LEFT
    def_bool $(shields_list_contains,phaethornis_left)
  
config SHIELD_PHAETHORNIS_RIGHT
    def_bool $(shields_list_contains,phaethornis_right)
  
```
